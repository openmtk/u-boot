## configs/mt8196_rauru_defconfig
```kconfig
CONFIG_ARM=y
# CONFIG_BOARD_INIT is not set
CONFIG_COUNTER_FREQUENCY=13000000
CONFIG_POSITION_INDEPENDENT=y
CONFIG_ARCH_MEDIATEK=y
CONFIG_NR_DRAM_BANKS=1
CONFIG_SYS_LOAD_ADDR=0x80000000
CONFIG_OF_UPSTREAM=y
CONFIG_CLK=y
CONFIG_MMC_MTK=y
CONFIG_PINCTRL=y
CONFIG_PINCONF=y
CONFIG_PINCTRL_MT8195=y
CONFIG_BAUDRATE=921600
CONFIG_DM_SERIAL=y
CONFIG_MTK_SERIAL=y
CONFIG_WDT=y
CONFIG_WDT_MTK=y
CONFIG_CROS_EC=y
CONFIG_DEFAULT_DEVICE_TREE="mediatek/mt8196-rauru-navi-sku0"
CONFIG_TARGET_MT8196=y
CONFIG_IDENT_STRING="mt8196-rauru-navi"

# Useful CMDs
CONFIG_CMD_CLK=y
CONFIG_CMD_GPT=y
CONFIG_CMD_MMC=y
CONFIG_CMD_PART=y
CONFIG_CMD_FAT=y
CONFIG_CMD_FS_GENERIC=y
CONFIG_CMD_EFIDEBUG=y

# Memory map
CONFIG_MTK_MEM_MAP_DDR_BASE_PHY=0x80000000
CONFIG_MTK_MEM_MAP_DDR_SIZE=0x20000000
CONFIG_MTK_MEM_MAP_MMIO_SIZE=0x40000000

# vidconsole
CONFIG_SYS_CONSOLE_IS_IN_ENV=y
CONFIG_SYS_CONSOLE_ENV_OVERWRITE=y
CONFIG_REQUIRE_SERIAL_CONSOLE=n
CONFIG_VIDEO=y
CONFIG_VIDEO_MTKFB=y
CONFIG_SYS_WHITE_ON_BLACK=y

# USB keyboard and gadgets
CONFIG_USB=y
CONFIG_USB_MUSB_GADGET=y
CONFIG_USB_MUSB_MT85XX=y
CONFIG_USB_MTU3=y
CONFIG_USB_GADGET=y
CONFIG_USB_STORAGE=y
CONFIG_DM_KEYBOARD=y
CONFIG_USB_KEYBOARD=y
CONFIG_USB_HOST=y
CONFIG_USB_XHCI_HCD=y
CONFIG_USB_XHCI_MTK=y
CONFIG_USB_EHCI_GENERIC=y
CONFIG_CMD_USB=y

# Start USB and find keyboard at boot
CONFIG_USE_PREBOOT=y
CONFIG_PREBOOT="usb start; sleep 1; setenv stdin usbkbd"

# DTB is big
CONFIG_SYS_INIT_SP_BSS_OFFSET=0x160000
```

## configs/rauru_coreboot_defconfig
```kconfig
CONFIG_ARM=y
CONFIG_SKIP_LOWLEVEL_INIT=y
CONFIG_POSITION_INDEPENDENT=y
CONFIG_ARCH_COREBOOT=y
CONFIG_SYS_COREBOOT=y
CONFIG_COREBOOT_SYSINFO=y
# CONFIG_MMC is not set
# CONFIG_MMC_PCI is not set
# CONFIG_SCSI is not set
# CONFIG_DM_SCSI is not set
# CONFIG_SCSI_AHCI is not set
# CONFIG_AHCI_PCI is not set
# CONFIG_USB is not set
# CONFIG_USB_XHCI_HCD is not set
# CONFIG_USB_EHCI_HCD is not set
# CONFIG_USB_STORAGE is not set
# CONFIG_USB_KEYBOARD is not set
# CONFIG_ETH_DESIGNWARE is not set
# CONFIG_RTL8169 is not set
# CONFIG_CMD_CBFS is not set
# CONFIG_FS_CBFS is not set
# CONFIG_CBMEM_CONSOLE is not set
# CONFIG_USE_PREBOOT is not set
# CONFIG_SYSINFO is not set
CONFIG_TEXT_BASE=0x80c00000
CONFIG_SYS_MALLOC_LEN=0x4000000
CONFIG_NR_DRAM_BANKS=32
CONFIG_SYS_INIT_SP_BSS_OFFSET=0x160000
CONFIG_OF_UPSTREAM=y
CONFIG_DEFAULT_DEVICE_TREE="mediatek/mt8196-rauru-navi-sku1"
CONFIG_SYS_LOAD_ADDR=0x80000000
CONFIG_REMAKE_ELF=y

# CONFIG_ARCH_FIXUP_FDT_MEMORY is not set

# pinctrl + gpio + clk
CONFIG_PINCTRL=y
CONFIG_PINCONF=y
CONFIG_PINCTRL_MT8196=y
CONFIG_CLK=y
CONFIG_CLK_MT8196=y
CONFIG_DM_REGULATOR=y
CONFIG_DM_REGULATOR_FIXED=y

# framebuffer (coreboot publishes geometry + base via sysinfo)
CONFIG_VIDEO=y
CONFIG_VIDEO_COREBOOT=y
CONFIG_VIDEO_LOGO=y
CONFIG_CONSOLE_MUX=y
CONFIG_CONSOLE_FLUSH_ON_NEWLINE=y
CONFIG_SYS_WHITE_ON_BLACK=y
CONFIG_CMD_CLS=y

# SPI + Chrome EC keyboard
CONFIG_SPI=y
CONFIG_DM_SPI=y
CONFIG_MTK_CHROMEOS_SPI=y
CONFIG_DM_GPIO=y
CONFIG_CROS_EC=y
CONFIG_CROS_EC_SPI=y
CONFIG_INPUT=y
CONFIG_DM_KEYBOARD=y
CONFIG_CROS_EC_KEYB=y
CONFIG_CMD_CROS_EC=y

# USB host (xhci); coreboot has powered the SSUSB PHYs already
CONFIG_USB=y
CONFIG_DM_USB=y
CONFIG_USB_HOST=y
CONFIG_USB_XHCI_HCD=y
CONFIG_USB_XHCI_MTK=y
CONFIG_USB_STORAGE=y
CONFIG_CMD_USB=y
CONFIG_PARTITION_UUIDS=y
CONFIG_FS_FAT=y
CONFIG_FS_EXT4=y
CONFIG_CMD_FS_GENERIC=y
CONFIG_CMD_EXT2=y
CONFIG_CMD_EXT4=y
CONFIG_CMD_FAT=y

CONFIG_CMD_CBSYSINFO=y

# reset / poweroff via PSCI -> TF-A
CONFIG_ARM_PSCI_FW=y
CONFIG_SYSRESET=y
CONFIG_SYSRESET_PSCI=y
CONFIG_CMD_POWEROFF=y

CONFIG_AUTOBOOT=n
# CONFIG_USE_PREBOOT is not set
# CONFIG_DISPLAY_CPUINFO is not set
# CONFIG_DISPLAY_BOARDINFO is not set
# CONFIG_CYCLIC is not set
CONFIG_HUSH_PARSER=y

CONFIG_LOGLEVEL=7
CONFIG_LOG_MAX_LEVEL=7
CONFIG_LOG_DEFAULT_LEVEL=3

# CONFIG_CMD_BDI is not set
# CONFIG_CMD_BOOTD is not set
# CONFIG_CMD_BOOTM is not set
# CONFIG_CMD_BOOTI is not set
# CONFIG_CMD_BOOTEFI is not set
# CONFIG_EFI_LOADER is not set
# CONFIG_BOOTSTD is not set
# CONFIG_DISTRO_DEFAULTS is not set

# console
CONFIG_SYS_NS16550=y
CONFIG_NS16550_SERIAL=y
# CONFIG_NS16550_DYNAMIC is not set

# early debug UART, hardcoded to mt8196 UART0
CONFIG_DEBUG_UART=y
CONFIG_DEBUG_UART_NS16550=y
CONFIG_DEBUG_UART_BASE=0x16000000
CONFIG_DEBUG_UART_CLOCK=26000000
CONFIG_DEBUG_UART_SHIFT=2
CONFIG_DEBUG_UART_BAUDRATE=115200
CONFIG_DEBUG_UART_ANNOUNCE=y
CONFIG_DEBUG_UART_SKIP_INIT=y
```

## drivers/clk/mediatek/Kconfig
```kconfig
# SPDX-License-Identifier: GPL-2.0+

config CLK_MT8196
	bool "Mediatek MT8196 clock driver"
	depends on CLK
	default y if TARGET_MT8196
	help
	  Enable the MediaTek MT8196 (Kompanio Ultra 910) clock driver.
	  Required for boards using the MT8196 SoC where U-Boot needs to
	  bind clocks for SoC peripherals (USB host, SPI, MMC, ...).
```
